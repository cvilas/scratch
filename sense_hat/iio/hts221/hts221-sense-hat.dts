/dts-v1/;
/plugin/;

/ {
    compatible = "brcm,bcm2835";

    fragment@0 {
        target = <&i2c1>;
        __overlay__ {
            #address-cells = <1>;
            #size-cells = <0>;
            
            hts221@5f {
                compatible = "st,hts221";
                reg = <0x5f>;
            };
        };
    };
};

